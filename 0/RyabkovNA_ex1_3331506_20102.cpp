#include <iostream>

int main()
{
    setlocale(LC_ALL,"RU");

    int A = 0; //Капиталы Alice (A) & Bob (B)
    int B = 0;
    //Условия ипотеки, при стоимости квартиры 13 000 000 рублей:
    int y = 30; //Лет
    int f = 1000000; //Первоначальный взнос
    int m = 161370; //Ежемесячный платёж по ипотеке, рассчитан с помощью калькулятора по ипотеке (ставка 16%)
    //Условия вклада:
    float p = 0.2; //Процент на остаток раз в год
    //Остальные вводные данные:
    float s = 200000; //Зарплата
    float i = 0.09; //Индексация зарплаты раз в год
    float e = 0.15; //Потребительская корзина (Оплата коммунальных услуг, еда, прочие затраты)
    int AC = 0; //Остаток по вкладам Alice 
    int BC = 1000000; //Остаток по вкладам Bob 
    float z = 30000; //Аренда квартиры
    float inf = 0.08; //Инфляция

    int ytemp = 1; //Текущий год
    int ACtemp = 0; //Профицит в текущем году Alice
    int BCtemp = 0; //Профицит в текущем году Bob

    

    while (ytemp <= y) {

        std::cout << ytemp << " " << "Год\n";

        //Рассчёты для Alice
        ACtemp = s * 12 - s * e * 12 - s * e * 12 * inf - m * 12; //Зарплата за год минус потреб корзина минус инфляция за год минус платёж по ипотеке за год
        AC = AC + ACtemp; //Сумма на вкладе
        A = AC + AC * p; //Начисленный процент на остаток средств на вкладе и  итоговая сумма на вкладе

        //Рассчёты для Bob
        BCtemp = s * 12 - s * e * 12 - s * e * 12 * inf - z * 12; //Зарплата за год минус потреб корзина минус инфляция за год минус аренда квартиры за год
        BC = BC + BCtemp; //Сумма на вкладе
        B = BC + BC * p; //Начисленный процент на остаток средств на вкладе и  итоговая сумма на вкладе

        std::cout << A << " " << "-" << " " << "Текущее состояние Alice\n";
        std::cout << B << " " << "-" << " " << "Текущее состояние Bob\n";
        std::cout << " \n";

        s = s + s * i; //Ежегодная индексация
        ACtemp = 0;
        BCtemp = 0;
        ++ytemp;
    }

    A = 13000000 + A;

    std::cout << A << " " << "-" << " " << "Состояние Alice\n";
    std::cout << B << " " << "-" << " " << "Состояние Bob\n";
    
    if (A > B)
        std::cout << "Ипотека выгоднее на\n" << " " << A - B ;
    else if (B > A)
        std::cout << "\nСъём квартиры выгоднее на" << " " << B - A ;
    else
        std::cout << "\nИ то, и то одинаково дорого\n";

    return 0;
}

